## designs/basic_passthru/config.in
```kconfig
mainmenu_name "Leon3 Hello World with passthrough ports"

mainmenu_option next_comment
  comment 'Synthesis      '
  source lib/techmap/gencomp/tech.in
endmenu

mainmenu_option next_comment
  comment 'Clock generation'
  source lib/techmap/clocks/clkgen.in
endmenu

source lib/gaisler/leon3/leon3.in
source lib/grlib/amba/amba.in

mainmenu_option next_comment
  comment 'Debug Link           '
  source lib/gaisler/uart/dcom.in
  source lib/gaisler/jtag/jtag.in
endmenu


mainmenu_option next_comment
comment 'Passthrough Ports                 '
  source lib/praesum/ahbpassthru/ahbpassthru.in
endmenu

mainmenu_option next_comment
comment 'On-chip ROM                 '
  source lib/gaisler/misc/ahbrom.in
endmenu

mainmenu_option next_comment
comment 'UART, timer, GPIO controller, and interrupt controller'
  source lib/gaisler/uart/uart1.in
  source lib/gaisler/leon3/irqmp.in
  source lib/gaisler/misc/gptimer.in
  source lib/gaisler/misc/grgpio.in
endmenu

mainmenu_option next_comment
comment 'VHDL Debugging        '
  source lib/grlib/util/debug.in
endmenu
```
